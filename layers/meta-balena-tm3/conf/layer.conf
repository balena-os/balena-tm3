## layers/meta-balena-tm3/conf/layer.conf
```bitbake
BBPATH .= ":${LAYERDIR}"

BBFILES += "${LAYERDIR}/recipes-*/*/*.bb \
            ${LAYERDIR}/recipes-*/*/*.bbappend"

BBFILE_COLLECTIONS += "balena-tm3"
BBFILE_PATTERN_balena-tm3 := "^${LAYERDIR}/"
BBFILE_PRIORITY_balena-tm3 = "1337"

LAYERSERIES_COMPAT_balena-tm3 = "kirkstone"

# this device type uses an old 4.9 kernel for which we cannot enable firmware compression support
FIRMWARE_COMPRESSION = "0"
```
